/*@!Encoding:1252*/
/*
 * VCU_Input_Sim.can
 * Sends VCU_Simulation (0x106) to drive VCU inputs.
 * Signal values are controlled via system variables (Environment -> System Variables -> VCU_Sim).
 */

variables {
  message VCU_Simulation msg_sim;
  msTimer sendTimer;
}

on start {
  setTimer(sendTimer, 20);  // 50 Hz
}

on timer sendTimer {
  msg_sim.Simulation_MUX     = 0;  // mux 0 = torque/pedal mode
  msg_sim.Sim_APPS           = (word)(@sysvar::VCU_Sim::APPS * 10.0);  // scale: 0.1
  msg_sim.Sim_BPS            = (word)(@sysvar::VCU_Sim::BPS  * 10.0);
  msg_sim.Sim_TS_ON          = @sysvar::VCU_Sim::TS_ON;
  msg_sim.Sim_R2D            = @sysvar::VCU_Sim::R2D;
  msg_sim.Sim_Torque_Request = 0;  // unused in pedal mode
  output(msg_sim);

  setTimer(sendTimer, 20);
}
